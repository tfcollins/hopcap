// SPDX-License-Identifier: GPL-2.0
/*
 * Adapted from vrt49 kernel/iio-vrt49-buffer/zynqmp-adrv9009zu11eg-vrt49-control-overlay.dts
 * (PROVENANCE.md) for the hopcap timed-dma profile (libdatax P3b, image candidate A).
 *
 * Upstream: "Combined VRT49 framer/UDP control and wide DAC-TX overlay for
 * adrv9009zu11eg_vrt49_corundum."
 *
 * Change: the iio_vrt49_deframer@84ab0000 node is removed. timed-dma builds vrt49 with
 * VRT_DAC_TX_ENABLE=0, so the fabric has no vrt49_dac_tx_0 at 0x84AB0000 (vrt49#91) and the
 * ADI TX DMA keeps feeding axi_tx_fifo. The stock axi-adrv9009-tx-hpc node keeps its dmas
 * (build_boot_artifacts.sh skips patch_adrv9009_tx_dma_owner.py on this profile). The framer
 * node (UDP control window, RX tap) and the external-PPS GPIO hog are unchanged.
 */
/dts-v1/;
/plugin/;

/ {
    fragment@0 {
        target-path = "/fpga-axi@0";

        __overlay__ {
            #address-cells = <2>;
            #size-cells = <1>;

            iio_vrt49_framer@84a80000 {
                compatible = "adi,axi-vrt49-framer-1.01.a",
                             "adi,axi-vrt49-framer-1.00.a";
                reg = <0x0 0x84a80000 0x1000>,
                      <0x0 0x84a90000 0x1000>;
                reg-names = "framer", "udp";

                adi,stream-id = <0x01000000>;
                adi,packet-mtu = <1472>;
                adi,pps-source-names = "corundum", "external";
                adi,nominal-sps = <245760000>;
                adi,pps-margin = <245760>;
                /* 17476266666667 = 0x00000fe5_02aaaaab Q32.32. */
                adi,ps-per-sample-q32 = /bits/ 64 <17476266666667>;
                adi,timebase-strict;
                adi,timebase-start-disabled;
            };
        };
    };

    fragment@1 {
        /* The deployed base DTB has no __symbols__ node. */
        target-path = "/axi/gpio@ff0a0000";

        __overlay__ {
            vrt49-external-pps-hog {
                gpio-hog;
                gpios = <94 0>;
                input;
                line-name = "vrt49-external-pps";
            };
        };
    };
};
